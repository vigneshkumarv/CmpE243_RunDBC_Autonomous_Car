VERSION ""

NS_ :

BS_:

BU_: BRIDGE MASTER GEO MOTOR SENSOR

BO_ 768 GEO_HEARTBEAT: 1 GEO
 SG_ GEO_HEARTBEAT_cmd : 0|8@1+ (1,0) [0|0] "" MASTER

BO_ 256 SENSOR_HEARTBEAT: 1 SENSOR
 SG_ SENSOR_HEARTBEAT_cmd : 0|8@1+ (1,0) [0|0] "" MASTER

BO_ 1024 BRIDGE_HEARTBEAT: 1 BRIDGE
 SG_ BRIDGE_HEARTBEAT_cmd : 0|8@1+ (1,0) [0|0] "" MASTER

BO_ 512 MOTOR_HEARTBEAT: 1 MOTOR
 SG_ MOTOR_HEARTBEAT_cmd : 0|8@1+ (1,0) [0|0] "" MASTER

BO_ 0 MASTER_HEARTBEAT: 1 MASTER
 SG_ MASTER_HEARTBEAT_cmd : 0|8@1+ (1,0) [0|0] "" MOTOR

BO_ 769 GEO_DATA: 1 GEO
 SG_ GEO_DATA_cmd : 0|8@1+ (1,0) [0|0] "" MASTER

BO_ 257 SENSOR_DATA: 1 SENSOR
 SG_ SENSOR_DATA_cmd : 0|8@1+ (1,0) [0|0] "" MASTER

BO_ 1025 BRIDGE_DATA: 1 BRIDGE
 SG_ BRIDGE_DATA_cmd : 0|8@1+ (1,0) [0|0] "" MASTER

BO_ 513 MOTOR_DATA: 1 MOTOR
 SG_ MOTOR_DATA_cmd : 0|8@1+ (1,0) [0|0] "" MASTER

BO_ 1 MASTER_SPEED: 1 MASTER
 SG_ MASTER_DATA_cmd : 0|8@1+ (1,0) [0|0] "" MOTOR

BA_DEF_ "BusType" STRING ;

BA_DEF_DEF_ "BusType" "CAN";
